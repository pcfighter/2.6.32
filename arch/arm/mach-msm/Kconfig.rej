## arch/arm/mach-msm/Kconfig.rej
```kconfig
--- arch/arm/mach-msm/Kconfig
+++ arch/arm/mach-msm/Kconfig
@@ -444,18 +444,14 @@
 
 endif # MSM_CPU_FREQ_SCREEN
 
-if MSM_CPU_FREQ_ONDEMAND || MSM_CPU_FREQ_USERSPACE || MSM_CPU_FREQ_MSM7K
-
 config MSM_CPU_FREQ_SCALING_MAX
-	int "Max"
+	int "CPU Scaling Max"
 	default 384000
 
 config MSM_CPU_FREQ_SCALING_MIN
-	int "Min"
+	int "CPU Scaling Min"
 	default 245760
 
-endif # MSM_CPU_FREQ
-
 config MSM_HW3D
 	tristate "MSM Hardware 3D Register Driver"
 	default y
```

## drivers/cpufreq/Kconfig.rej
```kconfig
--- drivers/cpufreq/Kconfig
+++ drivers/cpufreq/Kconfig
@@ -204,6 +210,14 @@
 
 	  If in doubt, say N.
 
+config CPU_FREQ_GOV_SMARTASS2
+	tristate "'smartassV2' cpufreq governor"
+	depends on CPU_FREQ
+	help
+      'smartassV2' - a "smart" optimized governor for the click!
+
+	  If in doubt, say N.
+
 config CPU_FREQ_MIN_TICKS
 	int "Ticks between governor polling interval."
 	default 10
```
